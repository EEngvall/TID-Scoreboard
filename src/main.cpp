#include <SPI.h>
#include <Wire.h>
#include <Adafruit_GFX.h>
#include <Adafruit_SSD1306.h>

#define SCREEN_WIDTH 128 // OLED display width, in pixels
#define SCREEN_HEIGHT 64 // OLED display height, in pixels

TwoWire I2Cone = TwoWire(0);
TwoWire I2Ctwo = TwoWire(1);

#define OLED_RESET -1  // Reset pin # (or -1 if sharing Arduino reset pin)
#define OLED_ADDR 0x3C // I2C address of both OLEDs

Adafruit_SSD1306 display1(SCREEN_WIDTH, SCREEN_HEIGHT, &I2Cone, OLED_RESET);
Adafruit_SSD1306 display2(SCREEN_WIDTH, SCREEN_HEIGHT, &I2Ctwo, OLED_RESET);
int homeScore = 0;
int awayScore = 0;
const int homeButton = 4;
const int awayButton = 2;
const int resetButton = 3;
int lastHomeButtonState = 1;

#define bitmap_width 128
#define bitmap_height 32

static const unsigned char PROGMEM logo[] = {
    // 'logo, 128x32px
    0x00, 0x00, 0x00, 0x00, 0x00, 0x3f, 0xff, 0xff, 0xff, 0xff, 0xe0, 0x00, 0x00, 0x00, 0x00, 0x00,
    0x00, 0x00, 0x00, 0x00, 0x00, 0x3f, 0xff, 0xff, 0xff, 0xff, 0xfc, 0x00, 0x00, 0x00, 0x00, 0x00,
    0x00, 0x00, 0x00, 0x00, 0x00, 0x00, 0x00, 0x00, 0x00, 0x00, 0x3f, 0x80, 0x00, 0x00, 0x00, 0x00,
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    0x00, 0x00, 0x00, 0x00, 0x03, 0xf6, 0x1f, 0xe3, 0xff, 0xf8, 0x00, 0x00, 0x00, 0x00, 0x00, 0x00};

static const unsigned char PROGMEM touchdown[] = {
    0x00, 0x00, 0x00, 0x00, 0x00, 0x00, 0x00, 0x00, 0x00, 0x00, 0x00, 0x00, 0x00, 0x00, 0x00, 0x00,
    0x00, 0x00, 0x00, 0x00, 0x00, 0x00, 0x00, 0x00, 0x00, 0x00, 0x00, 0x00, 0x00, 0x00, 0x00, 0x00,
    0x00, 0x00, 0x00, 0x00, 0x00, 0x00, 0x00, 0x00, 0x00, 0x00, 0x00, 0x00, 0x00, 0x00, 0x00, 0x00,
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    0x00, 0x00, 0x00, 0x00, 0x00, 0x00, 0x00, 0x00, 0x00, 0x00, 0x00, 0x00, 0x00, 0x00, 0x00, 0x00};

void showLogo(Adafruit_SSD1306 &display)
{
  display.clearDisplay();
  display.drawBitmap(0, 0, logo, bitmap_width, bitmap_height, WHITE);
  display.display();
  delay(1000);
}

void showTouchdown(Adafruit_SSD1306 &display)
{
  display.clearDisplay();
  display.drawBitmap(0, 0, touchdown, bitmap_width, bitmap_height, WHITE);
  display.display();
  delay(1000);
}

void incrementScore(Adafruit_SSD1306 &display, String team)
{
  // Calculate approx width of a digit at text size 3
  int digitWidth = 18; // 6 pixels wide at size 1, so 18 pixels at size 3

  // Calculate approx width of score string
  int scoreWidth = digitWidth * 2; // Always two digits

  // Calculate x cursor position to center text
  int xCursor = (128 - scoreWidth) / 2;

  // Increment the appropriate score
  int currentScore = 0;
  if (team == "Home")
  {
    homeScore = homeScore + 7;
    currentScore = homeScore;
  }
  else if (team == "Away")
  {
    awayScore = awayScore + 7;
    currentScore = awayScore;
  }

  // Create a string with leading zeros
  String scoreString = String(currentScore);
  if (currentScore < 10)
  {
    scoreString = "0" + scoreString;
  }

  showTouchdown(display);
  // Clear the display
  display.clearDisplay();

  // Set text size and color
  display.setTextSize(3);
  display.setTextColor(WHITE);

  // Set the cursor to the calculated position
  display.setCursor(xCursor, 17); // y is approximately centered

  // Display the score string
  display.print(scoreString);

  // Update the display
  display.display();
}

void setup()
{
  Serial.begin(9600);

  pinMode(homeButton, INPUT);
  pinMode(awayButton, INPUT);
  pinMode(resetButton, INPUT);

  I2Cone.begin(21, 22, 100000); // Initialize I2Cone with pins 21 (SDA), 22 (SCL)
  I2Ctwo.begin(19, 18, 100000); // Initialize I2Ctwo with pins 19 (SDA), 18 (SCL)

  // Initialize first display
  if (!display1.begin(SSD1306_SWITCHCAPVCC, OLED_ADDR))
  {
    Serial.println(F("SSD1306 allocation failed for display 1"));
    for (;;)
      ;
  }

  // Initialize second display
  if (!display2.begin(SSD1306_SWITCHCAPVCC, OLED_ADDR))
  {
    Serial.println(F("SSD1306 allocation failed for display 2"));
    for (;;)
      ;
  }

  // Show initial display buffer contents on the screen
  display1.clearDisplay();
  display2.clearDisplay();

  showLogo(display1);
  // Uncomment next line if you want the logo on the second display as well
  showLogo(display2);
}

void loop()
{
  // delay(1000);
  // incrementScore(display1, "Home");
  // incrementScore(display2, "Away");

  int homeButtonState = digitalRead(homeButton);

  if (homeButtonState != lastHomeButtonState)
  {
    if (homeButtonState == HIGH && lastHomeButtonState == LOW)
    {
      // if the current state is HIGH and the last state was LOW, then the button was pressed:
      incrementScore(display1, "Home"); // replace 'display' with the actual display object you are using
    }
    // Delay a little bit to avoid bouncing
    delay(1000);
  }

  // save the current state as the last state, for next time through the loop
  lastHomeButtonState = homeButtonState;
}
